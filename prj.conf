## CMakeLists.txt
```
cmake_minimum_required(VERSION 3.22)
set(BOARD esp32_devkitc_wrover/esp32/procpu)

find_package(Zephyr REQUIRED HINTS $ENV{ZEPHYR_BASE})
project(FW_Zephyr_IG_LTE)

# Include directories
# zephyr_include_directories(mqtt)
# zephyr_include_directories(modbus)
# zephyr_include_directories(modem)

target_sources(app PRIVATE src/main.c)
target_sources(app PRIVATE src/mqtt_IG/mqtt_IG.c)
target_sources(app PRIVATE src/modbus_IG/modbus_IG.c)
target_sources(app PRIVATE src/modem_IG/modem_IG.c)
```

## prj.conf
```kconfig
CONFIG_LOG=y
CONFIG_GPIO=y
CONFIG_SENSOR=y
CONFIG_SERIAL=y
CONFIG_UART_INTERRUPT_DRIVEN=y
CONFIG_UART_LINE_CTRL=n

CONFIG_MODBUS=y
CONFIG_MODBUS_ROLE_CLIENT=y
```

## src/main.c
```c
// #include <zephyr.h>
// #include <sys/printk.h>
#include <stdio.h>


#include "main.h"

#include "mqtt_IG/mqtt_IG.h"
#include "modbus_IG/modbus_IG.h"
#include "modem_IG/modem_IG.h"

int main(void)
{	
	modem_ig();

	modbus_ig();

	mqtt_ig();	
	
	return 0;
}
```

## src/main.h
```c
#ifndef MAIN_MAIN_H_
#define MAIN_MAIN_H_

#include <string.h>
#include <zephyr/kernel.h>

#include <zephyr/device.h>
#include <zephyr/drivers/gpio.h>
#include <zephyr/logging/log.h>
int main(void);
#endif /* MAIN_MAIN_H_ */
```
